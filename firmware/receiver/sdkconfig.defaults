## firmware/receiver/sdkconfig.defaults
```kconfig
CONFIG_ESP_CONSOLE_USB_SERIAL_JTAG=y
CONFIG_ESP_TASK_WDT_PANIC=y
CONFIG_ESP_TASK_WDT_TIMEOUT_S=3
CONFIG_ESP_SYSTEM_PANIC_SILENT_REBOOT=y
CONFIG_BOOTLOADER_APP_ROLLBACK_ENABLE=n
CONFIG_FREERTOS_HZ=1000
CONFIG_COMPILER_OPTIMIZATION_SIZE=y
CONFIG_COMPILER_STACK_CHECK_MODE_ALL=y
CONFIG_ESP_MAIN_TASK_STACK_SIZE=8192
CONFIG_LOG_DEFAULT_LEVEL_WARN=y

CONFIG_ESPTOOLPY_FLASHSIZE_16MB=y
```
